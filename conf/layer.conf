## conf/layer.conf
```bitbake
# We have a conf and classes directory, add to BBPATH
BBPATH .= ":${LAYERDIR}"

# We have recipes-* directories, add to BBFILES
BBFILES += "${LAYERDIR}/recipes-*/*/*.bb \
            ${LAYERDIR}/recipes-*/*/*.bbappend"

BBFILE_COLLECTIONS += "mytoyproject"
BBFILE_PATTERN_mytoyproject = "^${LAYERDIR}/"
BBFILE_PRIORITY_mytoyproject = "7"

LAYERDEPENDS_mytoyproject = "core"
LAYERSERIES_COMPAT_mytoyproject = "rocko sumo"
```
